

// #player
// все звуки кладём в папку мп3 на сд карту, стандарт скорости доступа - 10
// имена файлам даём в формате 0001.mp3 ... 0009.mp3, 0010.mp3
// плеер обращается к файлам по своему адресу (от 1 и увеличивая)
// в адресах файлов - кодируем информацию о принадлежности к ноте и тональности
// десятки (от 10 до 80) - обозначают тип ноты
// единицы (от 1 до 8) - тональность этой ноты
// итоговый адрес обозначаем цифрой(xx) в переменную note (например от 11 до 18 или от 21 до 28)
// используем кучу массивов для перебора и отсутсвии путанницы

// TroykaI2CHub
#include <TroykaI2CHub.h> // библиотека для работы с I²C хабом
TroykaI2CHub splitter;  // создаём объект для работы с хабом - адрес по умолчанию 0x70
// BH1750
#include <Wire.h> // BH1750: I2C device found at address 0x23
#include <BH1750.h> // библиотека для работы с BH1750
BH1750 lightMeter;  // создаём объект
// DFRobotDFPlayerMini-iarduino
#include <SoftwareSerial.h>              // Подключаем библиотеку для работы с последовательным интерфейсом
#include <DFRobotDFPlayerMini.h>         // Подключаем библиотеку для работы с плеером
// 1Player
#define RX1 2                             // Определяем вывод RX (TX на плеере) программного последовательного порта
#define TX1 3                             // Определяем вывод TX (RX на плеере) программного последовательного порта
SoftwareSerial mySoftwareSerial1(RX1, TX1); // создаём объект mySoftwareSerial и указываем выводы, к которым подключен плеер (RX, TX)
DFRobotDFPlayerMini myDFPlayer1;          // создаём объект myDFPlayer для работы с плеером
// 2Player
#define RX2 4                            // Определяем вывод RX (TX на плеере) программного последовательного порта
#define TX2 5                             // Определяем вывод TX (RX на плеере) программного последовательного порта
SoftwareSerial mySoftwareSerial2(RX2, TX2); // создаём объект mySoftwareSerial и указываем выводы, к которым подключен плеер (RX, TX)
DFRobotDFPlayerMini myDFPlayer2;          // создаём объект myDFPlayer для работы с плеером
// 3Player
#define RX3 6                             // Определяем вывод RX (TX на плеере) программного последовательного порта
#define TX3 7                             // Определяем вывод TX (RX на плеере) программного последовательного порта
SoftwareSerial mySoftwareSerial3(RX3, TX3); // создаём объект mySoftwareSerial и указываем выводы, к которым подключен плеер (RX, TX)
DFRobotDFPlayerMini myDFPlayer3;          // создаём объект myDFPlayer для работы с плеером
// Переменные
int i = 0;  //Переменная для перебора индексов массивов
// Массивы переменных для циклов проверки и реакций всех датчиков(по 8 штук)
int lux[8]; // Массивы переменных для циклов проверки и реакций всех датчиков(по 8 штук)
int oldLux[8];// Массивы переменных для циклов проверки и реакций всех датчиков(по 8 штук)
int newLux[8];// Массивы переменных для циклов проверки и реакций всех датчиков(по 8 штук)
// Массивы переменных для воспроизведения нот (кодируем ноты десяткам, а тональности их единицами)
int numb[8]; //переменная "номер" для перевода из индексной/портовой(от 0) нумерации в простую(от 1)
int ten[8]; //переменная для указания десятков ноты
int units[8]; //переменная для указания единиц ноты
int note[8]; //переменная указания номера и тональности ноты
//Магические числа - для настройки по-месту
int luxtrigger = 20; //Разница прошлого и текущего кол-ва люксов, при котором воспроизводим ноту
int timechannelpause = 5; //Время паузы между сменами каналов (5 -10-20милсек норм)
int timeplaypause = 30; //пауза для воспроизведения файла ноты милсек (0-100-250)
//Для смены плееров
int playernumber = 1; // номер плеера (дефолтный - первый из трёх)


void setup() {
  Serial.begin(115200);  // открываем последовательный порт для связи с пк
  ////while (!Serial) {  // ждём открытия порта
  ////}
  ////Serial.println("Serial init OK");  // печатаем сообщение об успешной инициализации
  splitter.begin();  // начало работы с I²C хабом
  ////Serial.println("Splitter init OK"); // печатаем сообщение об успешной инициализации
  lightMeter.begin(); // начало работы lightMeter
  ////Serial.println("lightMeter.begin.OK");  // печатаем сообщение об успешной инициализации
  //Player1
  mySoftwareSerial1.begin(9600); // инициализируем работу с программным mySoftwareSerial1 на скорости 9600 бод для Player1
  myDFPlayer1.begin(mySoftwareSerial1); //начало работы Player1
  myDFPlayer1.volume(30);  //громкость (от до 30) Player1
  ////Serial.println("Player1.begin.OK");  // печатаем сообщение об успешной инициализации
  //Player2
  mySoftwareSerial2.begin(9600); // инициализируем работу с программным mySoftwareSerial2 на скорости 9600 бод для Player2
  myDFPlayer2.begin(mySoftwareSerial2); //начало работы Player2
  myDFPlayer2.volume(30); //громкость (от до 30) Player2
  ////Serial.println("Player2.begin.OK");  // печатаем сообщение об успешной инициализации
  //Player3
  mySoftwareSerial3.begin(9600);  // инициализируем работу с программным mySoftwareSerial3 на скорости 9600 бод для Player3
  myDFPlayer3.begin(mySoftwareSerial3);  //начало работы Player3
  myDFPlayer3.volume(30); //громкость (от до 30) Player3
  ////Serial.println("Player3.begin.OK");  // печатаем сообщение об успешной инициализации
  //играем стартовую мелодию на 3х плеерах
  myDFPlayer1.playMp3Folder(11); //воспроизводим MP3 по адресу(XX) ноты (Ноты на SD:/MP3/ записаны в формате 0009.mp3/0010.mp3 итд)
  delay(300);  // ждём одну секунду
  myDFPlayer2.playMp3Folder(21); //воспроизводим MP3 по адресу(XX) ноты (Ноты на SD:/MP3/ записаны в формате 0009.mp3/0010.mp3 итд)
  delay(300);  // ждём одну секунду
  myDFPlayer3.playMp3Folder(31); //воспроизводим MP3 по адресу(XX) ноты (Ноты на SD:/MP3/ записаны в формате 0009.mp3/0010.mp3 итд)
  delay(300);  // ждём одну секунду
  myDFPlayer2.playMp3Folder(21); //воспроизводим MP3 по адресу(XX) ноты (Ноты на SD:/MP3/ записаны в формате 0009.mp3/0010.mp3 итд)
  delay(300);  // ждём одну секунду
  myDFPlayer1.playMp3Folder(11); //воспроизводим MP3 по адресу(XX) ноты (Ноты на SD:/MP3/ записаны в формате 0009.mp3/0010.mp3 итд)
  //delay
  delay(1000);  // ждём одну секунду
}


void loop() {

  for (i = 0; i <= 7; i++) {  // Перебираем индексы массивов и соответсвующие переменные
    splitter.setBusChannel(i); // Берём канал I2C-хаба в соответсвии с текущим i
    //Измеряем люксы
    lightMeter.begin(); // Инициализируем обьект lightMeter для получения данных с BH1750
    lux[i] = lightMeter.readLightLevel(); // Для текущего lux делаем измерения с BH1750 с соотв.канала хаба
    if (oldLux[i] == 0) { // Если первое измерение
      oldLux[i] = lux[i]; // Значения для oldLux берём такие же
    }
    newLux[i] = lux[i]; // Сохраняем текущее значение lux в переменную newLux

    //Если динамика люксов из света в темноту (появилась рука)
    if (oldLux[i] - newLux[i] >= luxtrigger) { // Если новое измерение меньше - т.е. темнее (появилась рука)
      ////Serial.print("chanel i:"); // Отображаем номер канала
      Serial.println(i); // Отображаем номер канала
      ////Serial.print("oldLux:"); // Отображаем номер канала
      ////Serial.println(oldLux[i]); // Отображаем номер канала
      ////Serial.print("newLux[i]"); // Отображаем номер канала
      ////Serial.println(newLux[i]); // Отображаем номер канала
      oldLux[i] = newLux[i]; // Записываем текущее значение в переменную предыдущего для след итерации
      //##Расчитываем ноту и тональность
      numb[i] = i + 1; //перевод в номера (от 1 до 8)
      ////Serial.print("numbNote:"); // Отображаем номер канала
      ////Serial.println(numb[i]); // Отображаем номер канала
      ten[i] = numb[i] * 10; //получаем десятки (от 10 до 80)
      //работаем с единицами, создаём их и сменяем от 1 до 8
      units[i]++; //индекс+1 и для изменения тональности воспроизведённой ноты
      if (units[i] >= 9) { //если больше чем есть в наличии
        units[i] = 1;  //сброс на дефолт
      }
      note[i] = ten[i] + units[i]; //получаем итоговый адрес XX ноты и её тональности
      ////Serial.print("note:");
      ////Serial.println(note[i]);
      ////Serial.print("----");
      //##Воспроизводим ноту, сменяя последовательно плееры
      if (playernumber == 1) {  // Если плеер 1 (дефолтный)
        myDFPlayer1.playMp3Folder(note[i]); //воспроизводим MP3 по адресу(XX) ноты (Ноты на SD:/MP3/ записаны в формате 0009.mp3/0010.mp3 итд)
      }
      if (playernumber == 2) { // Если плеер 2
        myDFPlayer2.playMp3Folder(note[i]); //воспроизводим MP3 по адресу(XX) ноты (Ноты на SD:/MP3/ записаны в формате 0009.mp3/0010.mp3 итд)
      }
      if (playernumber == 3) { // Если плеер 3
        myDFPlayer3.playMp3Folder(note[i]); //воспроизводим MP3 по адресу(XX) ноты (Ноты на SD:/MP3/ записаны в формате 0009.mp3/0010.mp3 итд)
      }
      playernumber++; // Меняем номер плеера для след итерации
      if (playernumber >= 4) { // Если превысили ко-во плееров
        playernumber = 1; // Возвращаемся к первому
      }
      delay(timeplaypause); //для воспр мелодии
    }

    //Если динамика люксов из тёмноты в свет (убрали руку)
    if (newLux[i] - oldLux[i] >= luxtrigger) { // Если новое измерение больше - т.е. светлее (убрали руку), то ничего не воспроизводим, лишь
      oldLux[i] = newLux[i]; // Записываем значение newLux в переменную предыдущего oldLux для след итерации
    }

    delay(timechannelpause); //для смены канала 10- 20милсек
  }
}
